## Kconfig
```kconfig
config EQUINOX_PAT_IDSEL_TEST
    bool "Diagnostic: compare PAT addresses with ID_SEL input, high and low"
    depends on I2C && GPIO && ZMK_HIRES_DIAL
    default n

config EQUINOX_PAT_DIAGNOSTICS
    bool "Equinox PAT9125 read-only diagnostics"
    depends on I2C && GPIO && ZMK_HIRES_DIAL
    default n

config EQUINOX_PMW_DIAGNOSTICS
    bool "Equinox PMW3610 readiness and split connection diagnostics"
    depends on PMW3610 && ZMK_SPLIT && !ZMK_SPLIT_ROLE_CENTRAL
    default n

config EQUINOX_CRASH_DIAGNOSTICS
    bool "Print retained watchdog incident details without clearing them"
    depends on ZMK_WATCHDOG && (EQUINOX_PMW_DIAGNOSTICS || EQUINOX_PAT_DIAGNOSTICS)
    default n
```

## boards/shields/GeaconEquinox/Kconfig.defconfig
```kconfig
if SHIELD_GEACON_EQUINOX_LEFT || SHIELD_GEACON_EQUINOX_RIGHT
config ZMK_KEYBOARD_NAME
    default "GeaconEquinox"
config ZMK_SPLIT
    default y
endif

if SHIELD_GEACON_EQUINOX_LEFT
config ZMK_SPLIT_ROLE_CENTRAL
    default y
config ZMK_SPLIT_BLE_CENTRAL_PERIPHERALS
    default 1
endif
```

## boards/shields/GeaconEquinox/Kconfig.shield
```kconfig
config SHIELD_GEACON_EQUINOX_LEFT
    def_bool $(shields_list_contains,geacon_equinox_left)

config SHIELD_GEACON_EQUINOX_RIGHT
    def_bool $(shields_list_contains,geacon_equinox_right)
```

## boards/shields/equinox_nemu/Kconfig.defconfig
```kconfig
if SHIELD_EQUINOX_NEMU_LEFT || SHIELD_EQUINOX_NEMU_RIGHT || SHIELD_EQUINOX_NEMU_DONGLE
config ZMK_KEYBOARD_NAME
    default "Equinox nemu"
config ZMK_SPLIT
    default y
config ZMK_SPLIT_ROLE_CENTRAL
    default y if SHIELD_EQUINOX_NEMU_DONGLE
    default n
endif
```

## boards/shields/equinox_nemu/Kconfig.shield
```kconfig
config SHIELD_EQUINOX_NEMU_LEFT
    def_bool $(shields_list_contains,equinox_nemu_left)

config SHIELD_EQUINOX_NEMU_RIGHT
    def_bool $(shields_list_contains,equinox_nemu_right)

config SHIELD_EQUINOX_NEMU_DONGLE
    def_bool $(shields_list_contains,equinox_nemu_dongle)
```

## config/west.yml
```yaml
manifest:
  remotes:
    - name: kot149
      url-base: https://github.com/kot149
    - name: cormoran
      url-base: https://github.com/cormoran
    - name: te9no
      url-base: https://github.com/te9no
  projects:
    - name: zmk-feature-watchdog
      remote: cormoran
      revision: 84ad14c6c3645dc40b23f45d08ab45418655f912
      path: modules/zmk-feature-watchdog
    - name: zmk-feature-kscan-diagnostics
      remote: cormoran
      revision: 1432f7fe0cfe903cd7d3c9931ae6bd6f2e1f328e
      path: modules/zmk-feature-kscan-diagnostics
    - name: zmk-module-devtool
      remote: cormoran
      revision: 9938a2c73c06d6e65ba2c0b68c9aa044a467eafc
      path: modules/zmk-module-devtool
    - name: zmk-feature-runtime-macro
      remote: cormoran
      revision: 38530962eb7061b60efcb98e84585cfb1f0cb6de
      path: modules/zmk-feature-runtime-macro
    - name: zmk-feature-runtime-combo
      remote: cormoran
      revision: d9490e7b5d41c516221d131241009e81740efcee
      path: modules/zmk-feature-runtime-combo
    - name: zmk-feature-custom-settings
      remote: cormoran
      revision: c6a7fef3a3be3d3ace5de9a4b0628c6418cd1f3f
      path: modules/zmk-feature-custom-settings
    - name: zmk-feature-device-info
      remote: cormoran
      revision: 8cedd2dd9f04e19ea5a17b94914dd47a09d8db11
      path: modules/zmk-feature-device-info
    - name: zmk-module-ble-management
      remote: cormoran
      revision: 57738cc4fc6ba80e82a7ac57741a0339cb186cd4
      path: modules/zmk-module-ble-management
    - name: zmk-module-settings-rpc
      remote: cormoran
      revision: 78f86df9e6c5edaf57bef3ccbd7f360cfdf49291
      path: modules/zmk-module-settings-rpc
    - name: zmk-module-runtime-input-processor
      remote: cormoran
      revision: decf628d7ce5ed95b520c650824c28ea9de649c1
      path: modules/zmk-module-runtime-input-processor
    - name: zmk-driver-hires-dial
      url: https://github.com/sekigon-gonnoc/zmk-driver-hires-dial
      revision: 353a21964a2f6df1de128ca6e71ec63518729ab7
      path: modules/zmk-driver-hires-dial
    - name: zmk-driver-animation
      remote: cormoran
      revision: fa0479ec3b2fe04a96d9244e620d3c5dd2cfb280
      path: modules/zmk-driver-animation
    - name: zmk-driver-ext-power-transient
      remote: cormoran
      revision: 92b00e3acb438df77c374a2f79857a8406c41bed
      path: modules/zmk-driver-ext-power-transient
    - name: zmk-rgbled-widget
      url: https://github.com/caksoylar/zmk-rgbled-widget
      revision: e6b467792a1dabef8cfa5c9fd26bfefc9c16662b
      path: modules/zmk-rgbled-widget
    - name: zmk-layout-shift
      remote: kot149
      revision: 4d71f7cb743256ac619873dd44f510e9e9562739
    - name: zmk
      remote: cormoran
      revision: e5c9b6915b56801193e359dd9bad4a167ce0d1b8
      import: app/west.yml
    - name: zmk-driver-pmw3610-with-custom-studio-rpc
      remote: cormoran
      revision: 5c34ea0eec246a1c986111417cd779b53144629a
    - name: zmk-driver-spi-three-wire
      remote: te9no
      revision: 4362133dbfbf66788b66b0a3e3c410b9232c06cb
      path: modules/zmk-driver-spi-three-wire
    - name: zmk-feature-cdc-acm-bootloader-trigger
      remote: te9no
      revision: 1850754d269aab9ba73e4639371bfe59a4130e65
  self:
    path: config
```

## dts/bindings/behaviors/te9no,behavior-nemu-layer-led.yaml
```yaml
description: Receiver layer indication
compatible: "te9no,behavior-nemu-layer-led"
include: one_param.yaml
```

## dts/bindings/sensor/te9no,equinox-nimh.yaml
```yaml
# SPDX-License-Identifier: MIT
description: Equinox single-cell NiMH divider
compatible: "te9no,equinox-nimh"
include: voltage-divider.yaml
properties:
  mv-to-pct-thresholds:
    type: array
    required: true
    description: Eleven ascending voltage thresholds, at ten percent intervals.
```

## nemu/west.yml
```yaml
manifest:
  remotes:
  - name: kot149
    url-base: https://github.com/kot149
  - name: cormoran
    url-base: https://github.com/cormoran
  - name: te9no
    url-base: https://github.com/te9no
  projects:
  - name: zmk-driver-hires-dial
    url: https://github.com/sekigon-gonnoc/zmk-driver-hires-dial
    revision: 353a21964a2f6df1de128ca6e71ec63518729ab7
    path: modules/zmk-driver-hires-dial
  - name: zmk-layout-shift
    remote: kot149
    revision: 4d71f7cb743256ac619873dd44f510e9e9562739
  - name: zmk-driver-pmw3610-with-custom-studio-rpc
    remote: cormoran
    revision: 5c34ea0eec246a1c986111417cd779b53144629a
  - name: zmk-driver-spi-three-wire
    remote: te9no
    revision: 4362133dbfbf66788b66b0a3e3c410b9232c06cb
    path: modules/zmk-driver-spi-three-wire
  - name: zmk
    url: https://github.com/sekigon-gonnoc/zmk
    revision: c2db9b12bf20b8cb7e938fe414d3347ed55a21a1
    import: app/west.yml
  - name: zmk-feature-nemu-link
    url: https://github.com/sekigon-gonnoc/zmk-feature-nemu-link
    revision: 6652c0e796d14005e4c6e826e9ca66efad765c94
    path: modules/zmk-feature-nemu-link
    import: config/west.yml
  - name: nrf
    url: https://github.com/sekigon-gonnoc/sdk-nrf
    revision: e53558a20c71f22f4eea527832896145deca0335
  - name: zephyr
    url: https://github.com/sekigon-gonnoc/zephyr
    revision: 4ee88178a632be8cf77b2a018fc2fbf49a3c27ac
    clone-depth: 1
    import:
      name-blocklist:
      - acpica
      - canopennode
      - cmsis-nn
      - cmsis_6
      - chre
      - ci-tools
      - edtt
      - fatfs
      - hal_adi
      - hal_altera
      - hal_ambiq
      - hal_atmel
      - hal_cypress
      - hal_espressif
      - hal_ethos_u
      - hal_gigadevice
      - hal_infineon
      - hal_intel
      - hal_microchip
      - hal_nuvoton
      - hal_nxp
      - hal_openisa
      - hal_quicklogic
      - hal_renesas
      - hal_rpi_pico
      - hal_silabs
      - hal_st
      - hal_stm32
      - hal_tdk
      - hal_telink
      - hal_ti
      - hal_wch
      - hal_wurthelektronik
      - hal_xtensa
      - hostap
      - liblc3
      - libmctp
      - libmetal
      - littlefs
      - loramac-node
      - lz4
      - mcuboot
      - mcumgr
      - mipi-sys-t
      - net-tools
      - nrf_hw_models
      - nrf_wifi
      - open-amp
      - openthread
      - percepio
      - psa-arch-tests
      - sof
      - tf-m-tests
      - tflite-micro
      - thrift
      - trusted-firmware-a
      - trusted-firmware-m
      - uoscore-uedhoc
      - zephyr-lang-rust
      - zscilib
  - name: zmk-feature-dynamic-settings
    url: https://github.com/sekigon-gonnoc/zmk-feature-dynamic-settings
    revision: cf7ccd1b4d3546d64205cf5f005a9db6ea6e5980
    path: modules/zmk-feature-dynamic-settings
  - name: zmk-feature-dynamic-input-processor
    url: https://github.com/sekigon-gonnoc/zmk-feature-dynamic-input-processor
    revision: 0db4bfacd6c4c8fa5821f48ca888d93f534618d4
    path: modules/zmk-feature-dynamic-input-processor
  - name: zmk-feature-cdc-acm-bootloader-trigger
    url: https://github.com/te9no/zmk-feature-cdc-acm-bootloader-trigger
    revision: 1850754d269aab9ba73e4639371bfe59a4130e65
    path: modules/zmk-feature-cdc-acm-bootloader-trigger
  self:
    path: config
```
